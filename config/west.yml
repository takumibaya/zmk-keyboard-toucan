## firmware/Kconfig
```kconfig
# Toucan firmware module. The repository root is the Zephyr module
# (zephyr/module.yml); everything here builds only on the left half
# (central). The right half (peripheral) stays unchanged.

menuconfig TOUCAN_STUDIO
    bool "Toucan Studio custom RPC (toucan__studio)"
    default y
    depends on ZMK_STUDIO_RPC
    help
      Registers the custom Studio RPC subsystem "toucan__studio"
      (protocol: firmware/proto/toucan/studio.proto). Requires the
      takumibaya/zmk fork with the custom RPC subsystem.

if TOUCAN_STUDIO

config TOUCAN_STUDIO_COMBO
    bool "Runtime combos over toucan__studio"
    default y
    depends on ZMK_COMBOS_RUNTIME
    depends on SETTINGS && ZMK_BEHAVIOR_LOCAL_IDS && ZMK_BEHAVIOR_METADATA
    select CRC
    help
      List / set / delete / restore combos at runtime. Needs the runtime
      combo engine of the zmk fork (CONFIG_ZMK_COMBOS_RUNTIME).

config TOUCAN_STUDIO_MACRO
    bool "Runtime macros (&rtm) over toucan__studio"
    default y
    depends on DT_HAS_TOUCAN_BEHAVIOR_RUNTIME_MACRO_ENABLED
    depends on SETTINGS && ZMK_BEHAVIOR_LOCAL_IDS

if TOUCAN_STUDIO_MACRO

config TOUCAN_STUDIO_MACRO_SLOTS
    int "Runtime macro slots"
    default 8
    range 1 8

config TOUCAN_STUDIO_MACRO_MAX_STEPS
    int "Steps per runtime macro"
    default 32
    range 1 32

config TOUCAN_STUDIO_MACRO_MAX_QUEUE_ITEMS
    int "Actions per runtime macro (TAP = 2, PRESS/RELEASE = 1, PAUSE = 0)"
    default 60
    range 1 ZMK_BEHAVIORS_QUEUE_SIZE
    help
      Limits the number of behavior invocations in one runtime macro.

config TOUCAN_STUDIO_MACRO_HELD
    int "Concurrent runtime macro runs"
    default 2
    range 1 8
    help
      Concurrently running or held &rtm macros with snapshotted steps.
      A press beyond this limit is ignored and logged.

endif # TOUCAN_STUDIO_MACRO

config TOUCAN_STUDIO_POINTER
    bool "Runtime pointer settings over toucan__studio"
    default y
    depends on ZMK_POINTING
    depends on !ZMK_SPLIT || ZMK_SPLIT_ROLE_CENTRAL
    help
      Acceleration parameters (zmk-pointing-acceleration-alpha fork) and
      the cursor / scroll multipliers of the runtime scalers.

config TOUCAN_STUDIO_GESTURE
    bool "Runtime touch gesture settings over toucan__studio"
    default y
    depends on TOUCAN_TOUCH_GESTURES && TOUCAN_BEHAVIOR_GESTURE_SWITCH
    depends on SETTINGS && ZMK_BEHAVIOR_LOCAL_IDS
    help
      Tap-to-click (and rim scroll) parameters with save / discard /
      restore. The &tgs key changes the same on/off flags.

endif # TOUCAN_STUDIO

config TOUCAN_BEHAVIOR_RUNTIME_MACRO
    bool
    default y
    depends on DT_HAS_TOUCAN_BEHAVIOR_RUNTIME_MACRO_ENABLED
    depends on TOUCAN_STUDIO_MACRO

config TOUCAN_INPUT_PROCESSOR_RUNTIME_SCALER
    bool
    default y
    depends on DT_HAS_TOUCAN_INPUT_PROCESSOR_RUNTIME_SCALER_ENABLED
    depends on ZMK_POINTING
    depends on !ZMK_SPLIT || ZMK_SPLIT_ROLE_CENTRAL
    help
      Needed whenever the input listener references the runtime scalers
      (also without Studio), so it does not depend on TOUCAN_STUDIO.

config TOUCAN_TOUCH_GESTURES
    bool
    default y
    depends on DT_HAS_TOUCAN_INPUT_GESTURES_ENABLED
    depends on ZMK_POINTING
    depends on !ZMK_SPLIT || ZMK_SPLIT_ROLE_CENTRAL
    help
      Needed whenever an input listener uses the gestures node as its
      device (also without Studio), so it does not depend on TOUCAN_STUDIO.

config TOUCAN_TOUCH_GESTURES_INIT_PRIORITY
    int "Touch gestures device init priority"
    default 99
    depends on TOUCAN_TOUCH_GESTURES
    help
      POST_KERNEL priority; must come after the source input device
      (e.g. ZMK_INPUT_SPLIT_INIT_PRIORITY) and the click behavior.

config TOUCAN_BEHAVIOR_GESTURE_SWITCH
    bool
    default y
    depends on DT_HAS_TOUCAN_BEHAVIOR_GESTURE_SWITCH_ENABLED
    depends on TOUCAN_TOUCH_GESTURES
```

## firmware/dts/bindings/behaviors/toucan,behavior-gesture-switch.yaml
```yaml
# SPDX-License-Identifier: MIT

description: Touch gesture on/off key (param1 TGS_TOG / TGS_ON / TGS_OFF)

compatible: "toucan,behavior-gesture-switch"

include: one_param.yaml
```

## firmware/dts/bindings/behaviors/toucan,behavior-runtime-macro.yaml
```yaml
# SPDX-License-Identifier: MIT

description: Toucan runtime macro slot

compatible: "toucan,behavior-runtime-macro"

include: one_param.yaml
```

## firmware/dts/bindings/input/toucan,input-gestures-wheel.yaml
```yaml
# SPDX-License-Identifier: MIT

description: |
  Output device of the rim scroll of a toucan,input-gestures node (its wheel-device). A
  zmk,input-listener without input processors that uses this node as its `device` turns
  the REL_WHEEL events into HID scroll, away from the cursor chain.

compatible: "toucan,input-gestures-wheel"
```

## firmware/dts/bindings/input/toucan,input-gestures.yaml
```yaml
# SPDX-License-Identifier: MIT

description: |
  Touch gestures between a trackpad input device and the zmk,input-listener that uses
  this node as its `device` (see firmware/src/touch_gestures.c). Events go through
  unchanged while the gestures are off. tap/rim and the tap-*/rim-* values are the
  defaults that Studio's restore_defaults returns to.

compatible: "toucan,input-gestures"

properties:
  device:
    type: phandle
    required: true
    description: Source input device, e.g. the zmk,input-split proxy of the trackpad half
  bindings:
    type: phandle-array
    required: true
    description: Behavior pressed and released for a tap, e.g. <&mkp LCLK>
  aux-code:
    type: int
    default: 0
    description: EV_ABS code of the source's aux position (x | y << 11, 0..1024); 0 = none
  wheel-device:
    type: phandle
    description: |
      toucan,input-gestures-wheel node whose zmk,input-listener (without processors) gets the
      rim scroll's REL_WHEEL events. Rim scroll is built only with this and aux-code.
  aux-timeout-ms:
    type: int
    default: 100
    description: |
      A scrolling rim touch whose finger keeps moving without a new aux sample for this long
      goes back to cursor (the right skips unchanged positions, so a resting finger is fine)
  click-ms:
    type: int
    default: 30
    description: Time between the press and the release of the tap binding
  contact-timeout-ms:
    type: int
    default: 250
    description: |
      A gesturing touch without any source event for this long fails open: it stops
      gesturing and a forwarded BTN_TOUCH press is released once.
  tap:
    type: boolean
    description: Tap-to-click on by default
  tap-ms:
    type: int
    default: 170
    description: Longest BTN_TOUCH press-to-release that clicks
  tap-move:
    type: int
    default: 44
    description: Peak Manhattan displacement from touch-down in raw sensor counts; also gates rim detection
  rim:
    type: boolean
    description: Rim scroll on by default
  rim-width:
    type: int
    default: 15
    description: Outer band required once movement exceeds tap-move, % of the calibrated ellipse radius
  rim-start-deg:
    type: int
    default: 20
    description: Magnitude of net rotation in ellipse-normalized degrees before scrolling starts
  rim-steps:
    type: int
    default: 4
    description: Wheel steps per 90 degrees
  rim-reverse:
    type: boolean
    description: Clockwise scrolls up (default down)
```

## firmware/dts/bindings/input_processors/toucan,input-processor-runtime-scaler.yaml
```yaml
# SPDX-License-Identifier: MIT

description: Input processor with a runtime-adjustable scale ratio
compatible: "toucan,input-processor-runtime-scaler"
include: ip_zero_param.yaml

properties:
  type:
    type: int
    required: true
  codes:
    type: array
    required: true
  default-mul:
    type: int
    required: true
  default-div:
    type: int
    required: true
```
