## config/west.yml
```yaml
manifest:
  defaults:
    revision: v0.3
  remotes:
    - name: zmkfirmware
      url-base: https://github.com/zmkfirmware
    - name: petejohanson
      url-base: https://github.com/petejohanson
    - name: caksoylar
      url-base: https://github.com/caksoylar
    - name: geeksville
      url-base: https://github.com/geeksville
    - name: nuovotaka
      url-base: https://github.com/nuovotaka
  projects:
    - name: zmk
      remote: zmkfirmware
      import: app/west.yml
    - name: cirque-input-module
      url: https://github.com/takumibaya/cirque-input-module
      revision: fix/interrupt-deadlock-recovery
    - name: zmk-rgbled-widget
      remote: caksoylar
      revision: main
    - name: zmk-input-gestures
      url: https://github.com/takumibaya/zmk-input-gestures
      # fix/gesture-suppression-selfheal: suppression-latch 自己回復 + NULL raw_event_1 ガード
      # （トラックパッド突然死＋APL固定の対策。安定確認後に main へ取り込み可）
      revision: fix/gesture-suppression-selfheal
    - name: zmk-pointing-acceleration-alpha
      remote: nuovotaka
      revision: main
  self:
    path: config
```
